## config/boards/shields/StagErgo/Kconfig.defconfig
```kconfig
# Copyright (c) 2020 Pete Johanson, Kurtis Lew
# SPDX-License-Identifier: MIT

if SHIELD_StagErgo_LEFT

config ZMK_KEYBOARD_NAME
    default "StagErgo"

config ZMK_SPLIT_ROLE_CENTRAL
    default y

endif

if SHIELD_StagErgo_LEFT || SHIELD_StagErgo_RIGHT

config ZMK_SPLIT
    default y

endif
```

## config/boards/shields/StagErgo/Kconfig.shield
```kconfig
# Copyright (c) 2020 Pete Johanson, Kurtis Lew
# SPDX-License-Identifier: MIT

config SHIELD_StagErgo_LEFT
    def_bool $(shields_list_contains,StagErgo_left)

config SHIELD_StagErgo_RIGHT
    def_bool $(shields_list_contains,StagErgo_right)
```
